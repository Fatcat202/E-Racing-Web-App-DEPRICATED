VERSION ""

NS_ :

BS_:

BU_:

BO_ 1 Status: 1 Vector__XXX
 SG_ Satellites : 3|5@1+ (1,0) [0|31] "" Vector__XXX

BO_ 2 Time: 6 Vector__XXX
 SG_ Epoch : 8|40@1+ (1,0) [0|0] "sec" Vector__XXX

BO_ 3 Position: 8 Vector__XXX
 SG_ Latitude : 1|28@1+ (1e-06,-90) [-90|90] "deg" Vector__XXX
 SG_ Longitude : 29|29@1+ (1e-06,-180) [-180|180] "deg" Vector__XXX

BO_ 6 Odo: 8 Vector__XXX
 SG_ DistanceTotal : 42|22@1+ (1,0) [0|4194303] "km" Vector__XXX

BO_ 7 Speed: 5 Vector__XXX
 SG_ Speed : 1|20@1+ (0.001,0) [0|1048.575] "M/H" Vector__XXX

BO_ 9 Imu: 8 Vector__XXX
 SG_ AccelerationX : 1|10@1+ (0.125,-63.5) [0.334|63.875] "m/s^2" Vector__XXX
 SG_ AngularRateX : 31|11@1+ (0.25,-255.5) [0.335|255.75] "deg/s" Vector__XXX

BO_ 0 Accelaration: 8 Vector__XXX
 SG_ Accelaration : 0|8@1+ (0,-2000) [0|0] "" Vector__XXX

CM_ BO_ 1 "information";
CM_ SG_ 1 Satellites "Number of satellites used";
CM_ BO_ 2 "time";
CM_ SG_ 2 Epoch "time";
CM_ BO_ 3 "position";
CM_ SG_ 3 Latitude "Latitude";
CM_ SG_ 3 Longitude "Longitude";
CM_ BO_ 6 "odometer";
CM_ SG_ 6 DistanceTotal "Distance traveled in total";
CM_ BO_ 7 "speed";
CM_ SG_ 7 Speed "Speed m/s";
CM_ BO_ 9 "IMU";
CM_ SG_ 9 AccelerationX "X acceleration with a resolution of 0.125 m/s^2";
CM_ SG_ 9 AngularRateX "X angular rate with a resolution of 0.25 deg/s";
CM_ BO_ 0 "Accelaration";

BA_DEF_ BO_  "VFrameFormat" ENUM  "StandardCAN","ExtendedCAN","reserved","J1939PG";
BA_DEF_  "BusType" STRING;
BA_DEF_  "ProtocolType" STRING;
BA_DEF_DEF_  "BusType" "";
BA_DEF_DEF_  "ProtocolType" "";
BA_DEF_DEF_  "VFrameFormat" "StandardCAN";
BA_ "BusType" "CAN";

VAL_ 4 AltitudeValid 0 "Invalid" 1 "Valid" ;
VAL_ 5 AttitudeValid 0 "Invalid" 1 "Valid" ;
VAL_ 8 FenceValid 0 "Invalid" 1 "Valid" ;
VAL_ 8 FenceCombined 0 "Unknown" 1 "Inside" 2 "Outside" ;
VAL_ 8 Fence1 0 "Unknown" 1 "Inside" 2 "Outside" ;
VAL_ 8 Fence2 0 "Unknown" 1 "Inside" 2 "Outside" ;
VAL_ 8 Fence3 0 "Unknown" 1 "Inside" 2 "Outside" ;
VAL_ 8 Fence4 0 "Unknown" 1 "Inside" 2 "Outside" ;
